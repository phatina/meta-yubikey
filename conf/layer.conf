## conf/layer.conf
```bitbake
# We have a conf and classes directory, add to BBPATH
BBPATH .= ":${LAYERDIR}"

# We have recipes-* directories, add to BBFILES
BBFILES += "${LAYERDIR}/recipes-*/*/*.bb \
            ${LAYERDIR}/recipes-*/*/*.bbappend"

BBFILE_COLLECTIONS += "yubikey"
BBFILE_PATTERN_yubikey = "^${LAYERDIR}/"
BBFILE_PRIORITY_yubikey = "6"

LAYERSERIES_COMPAT_yubikey = "zeus"
```
